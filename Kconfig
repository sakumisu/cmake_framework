## components/Kconfig
```kconfig
menu "SDK Components"

source "$SDK_BASE/components/component1/Kconfig"
source "$SDK_BASE/components/component2/Kconfig"
source "$SDK_BASE/components/component3/Kconfig"

endmenu
```

## components/component1/Kconfig
```kconfig
menuconfig COMPONENT1
    bool "component1"
    default y

if COMPONENT1

    config XXX
        bool
        default y

endif
```

## components/component2/Kconfig
```kconfig
menuconfig COMPONENT2
    bool "component3"
    default y

if COMPONENT2

    config XXX2
        bool
        default y

endif
```

## components/component3/Kconfig
```kconfig
menuconfig COMPONENT3
    bool "component3"
    default y

if COMPONENT3

    config XXX3
        bool
        default y

endif
```

## examples/helloworld2/Kconfig
```kconfig
mainmenu "SDK Configuration"

config SDK_BASE
    string
    option env="SDK_BASE"

source "$SDK_BASE/Kconfig"
```
